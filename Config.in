## configs/plumos_rg280v_defconfig
```kconfig
# OpenDingux 2023.11 / RG280V first bring-up. Keep this file small.
BR2_mipsel=y
BR2_mips_32r2=y
BR2_TOOLCHAIN_BUILDROOT_VENDOR="gcw0"
BR2_TOOLCHAIN_BUILDROOT_UCLIBC=y
BR2_UCLIBC_CONFIG="board/opendingux/gcw0/uclibc.config"
BR2_TOOLCHAIN_BUILDROOT_WCHAR=y
BR2_PTHREAD_DEBUG=y
BR2_EXTRA_GCC_CONFIG_OPTIONS="--with-mips-plt"
BR2_TOOLCHAIN_BUILDROOT_CXX=y
BR2_TARGET_OPTIMIZATION="-pipe -fipa-pta"
BR2_OPTIMIZE_2=y
BR2_GLOBAL_PATCH_DIR="$(TOPDIR)/board/opendingux/patches"
# BR2_PIC_PIE is not set
BR2_RELRO_NONE=y
BR2_ROOTFS_SKELETON_CUSTOM=y
BR2_ROOTFS_SKELETON_CUSTOM_PATH="board/opendingux/target_skeleton"
BR2_ROOTFS_DEVICE_CREATION_DYNAMIC_EUDEV=y
BR2_ROOTFS_DEVICE_TABLE="$(BR2_EXTERNAL_PLUMOS_JZ_PATH)/board/rg280v/device_table.txt"
BR2_ROOTFS_MERGED_USR=y
BR2_ROOTFS_USERS_TABLES="board/opendingux/users.txt"
BR2_ROOTFS_OVERLAY="board/opendingux/gcw0/overlay $(BR2_EXTERNAL_PLUMOS_JZ_PATH)/board/rg280v/overlay"
BR2_ROOTFS_POST_BUILD_SCRIPT="board/opendingux/gcw0/cleanup-rootfs.sh $(BR2_EXTERNAL_PLUMOS_JZ_PATH)/board/rg280v/post-build.sh board/opendingux/create-modules-fs.sh"
BR2_ROOTFS_POST_IMAGE_SCRIPT="board/opendingux/create-opk.sh"
BR2_ROOTFS_POST_SCRIPT_ARGS="gcw0"
BR2_LINUX_KERNEL=y
BR2_LINUX_KERNEL_CUSTOM_TARBALL=y
BR2_LINUX_KERNEL_CUSTOM_TARBALL_LOCATION="https://github.com/OpenDingux/linux/archive/3181c26b25ab.tar.gz"
BR2_LINUX_KERNEL_USE_CUSTOM_CONFIG=y
BR2_LINUX_KERNEL_CUSTOM_CONFIG_FILE="board/opendingux/gcw0/linux_defconfig"
BR2_LINUX_KERNEL_CONFIG_FRAGMENT_FILES="$(BR2_EXTERNAL_PLUMOS_JZ_PATH)/configs/kernel-rg280v-usb.fragment"
BR2_LINUX_KERNEL_IMAGE_TARGET_CUSTOM=y
BR2_LINUX_KERNEL_ZSTD=y
BR2_LINUX_KERNEL_IMAGE_TARGET_NAME="uzImage.bin"
BR2_LINUX_KERNEL_IMAGE_NAME="uzImage.bin"
BR2_LINUX_KERNEL_DTS_SUPPORT=y
BR2_LINUX_KERNEL_INTREE_DTS_NAME="ingenic/rg280v"
BR2_LINUX_KERNEL_NEEDS_HOST_OPENSSL=y
BR2_PACKAGE_HOST_UBOOT_TOOLS=y
BR2_PACKAGE_HOST_UBOOT_TOOLS_FIT_SUPPORT=y
BR2_PACKAGE_BUSYBOX_CONFIG="board/opendingux/busybox.config"
BR2_PACKAGE_ALSA_UTILS=y
BR2_PACKAGE_ALSA_UTILS_AMIXER=y
BR2_PACKAGE_ALSA_UTILS_APLAY=y
BR2_PACKAGE_DOSFSTOOLS=y
BR2_PACKAGE_DOSFSTOOLS_FSCK_FAT=y
BR2_PACKAGE_DOSFSTOOLS_MKFS_FAT=y
BR2_PACKAGE_E2FSPROGS=y
BR2_PACKAGE_E2FSPROGS_RESIZE2FS=y
BR2_PACKAGE_MESA3D=y
BR2_PACKAGE_MESA3D_GALLIUM_DRIVER_ETNAVIV=y
BR2_PACKAGE_MESA3D_OPENGL_EGL=y
BR2_PACKAGE_MESA3D_OPENGL_ES=y
BR2_PACKAGE_PSPLASH=y
BR2_PACKAGE_SDL_IMAGE=y
BR2_PACKAGE_SDL_IMAGE_PNG=y
BR2_PACKAGE_SDL_MIXER=y
BR2_PACKAGE_LIBVORBIS=y
BR2_PACKAGE_SDL2_KMSDRM=y
BR2_PACKAGE_SDL2_OPENGLES=y
BR2_PACKAGE_EVTEST=y
BR2_PACKAGE_ANDROID_TOOLS=y
BR2_PACKAGE_ANDROID_TOOLS_ADBD=y
BR2_PACKAGE_DROPBEAR=y
BR2_PACKAGE_DROPBEAR_DISABLE_REVERSEDNS=y
BR2_PACKAGE_XINETD=y
BR2_PACKAGE_SUDO=y
BR2_PACKAGE_KMOD_TOOLS=y
BR2_PACKAGE_UTIL_LINUX_BINARIES=y
BR2_PACKAGE_UTIL_LINUX_LOSETUP=y
BR2_PACKAGE_UTIL_LINUX_ZRAMCTL=y
BR2_PACKAGE_STRACE=y
BR2_TARGET_ROOTFS_SQUASHFS=y
BR2_TARGET_ROOTFS_SQUASHFS4_ZSTD=y
# BR2_TARGET_ROOTFS_TAR is not set
BR2_PACKAGE_GMENU2X=y
BR2_PACKAGE_LIBOPK=y
BR2_PACKAGE_LIBXDGMIME=y
BR2_PACKAGE_MININIT=y
BR2_PACKAGE_PWSWD=y
BR2_PACKAGE_PWSWD_BACKENDS="volume;brightness;poweroff;reboot"
BR2_PACKAGE_SALSAD=y
BR2_PACKAGE_UBIBOOT=y
BR2_PACKAGE_UBIBOOT_BOARDNAME="gcw0"
```
